## buildroot-2019.02/package/python-evdev/Config.in
```kconfig
config BR2_PACKAGE_PYTHON_EVDEV
	bool "python-evdev"	
	select BR2_PACKAGE_PYTHON_CFFI
	help
	  Python wrapper for linux input events.
	  http://github.com/gvalkov/python-evdev
```

## buildroot-2019.02/package/python-tabulate/Config.in
```kconfig
config BR2_PACKAGE_PYTHON_TABULATE
	bool "python-tabulate"
	help
	  Pretty-print tabular data.

	  https://bitbucket.org/astanin/python-tabulate
```
